## config/west.yml
```yaml
manifest:
  remotes:
    - name: zmkfirmware
      url-base: https://github.com/zmkfirmware
  projects:
    - name: zmk
      remote: zmkfirmware
      revision: main
      import: app/west.yml
  self:
    path: config

include:
  - board: seeeduino_xiao_ble
    shield: totem_left
  - board: seeeduino_xiao_ble
    shield: totem_right
  - board: seeeduino_xiao_ble
    shield: settings_reset
  - board: seeeduino_xiao_ble
    shield: totem_central
    cmake-args: '-DCONFIG_ZMK_USB_LOGGING=y'
```
